## main/Kconfig.projbuild
```kconfig
menu "sention_b2_control Configuration"

config WIFI_SSID
    string "WIFI SSID"
config WIFI_PASSWORD
    string "WIFI Password"

config MQTT_SERVER
    string "MQTT Server (IP)"
config MQTT_PORT
    int "MQTT Port"
    default 1883
config MQTT_ID
    string "MQTT Client ID"
config MQTT_USER
    string "MQTT User"
config MQTT_PASSWORD
    string "MQTT Passowrd"

config TX_GPIO
    int "TX GPIO number"
	range 0 34
	default 4
config RX_GPIO
    int "RX GPIO number"
	range 0 34
	default 5

config REMOTELOG_UDP_HOST
    string "Remote Log UDP hostname"
config REMOTELOG_UDP_PORT
    int "Remote Log UDP Port"
    default 12345
config REMOTELOG_SYSLOG_HOST
    string "Remote Log Syslog hostname"
config REMOTELOG_SYSLOG_PORT
    int "Remote Log Syslog Port"
    default 514
config REMOTELOG_SYSLOG_APP
    string "Remote Log Syslog application"
    default "sentio-b2"


endmenu
```
